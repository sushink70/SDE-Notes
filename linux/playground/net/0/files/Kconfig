## linux/playground/net/0/files/Kconfig
```kconfig
# Kconfig — place in drivers/net/edu_net/Kconfig
#
# Kernel configuration for the educational net subsystem module.
# Follows the conventions in Documentation/kbuild/kconfig-language.rst

config EDU_NET
	tristate "Educational virtual NIC (C implementation)"
	depends on NET && NETDEVICES && ETHERNET
	select NETDEV_LEGACY_INIT
	help
	  A minimal virtual Ethernet NIC for studying the Linux kernel
	  network subsystem. Demonstrates: alloc_netdev, net_device_ops,
	  sk_buff lifecycle, NAPI polling, per-CPU stats (u64_stats_sync),
	  and ethtool_ops.

	  If unsure, say N. Build as module (M) for easier iteration.

config EDU_NET_RS
	tristate "Educational virtual NIC (Rust implementation)"
	depends on NET && NETDEVICES && RUST
	help
	  Rust version of EDU_NET. Requires CONFIG_RUST=y and a kernel
	  built with the Rust toolchain (rustup + bindgen ≥ 0.65).

	  If unsure, say N.
```

## linux/playground/security/0/files/Kconfig.fragment
```kconfig
# Paste this block into security/Kconfig (after the AppArmor stanza, for example).
#
# For the LSM ordering stanza in security/Kconfig (CONFIG_LSM default):
#   default "lockdown,yama,loadpin,safesetid,smack,selinux,tomoyo,apparmor,bpf,sentinel"

config SECURITY_SENTINEL
	bool "Sentinel Linux Security Module"
	depends on SECURITY
	default n
	help
	  This enables the Sentinel LSM, a stacked security module that
	  provides:
	    - Path-prefix deny-list for file_open
	    - Setuid-exec blocking for non-root processes
	    - Outbound RFC-1918 socket_connect blocking for non-root

	  It stacks on top of SELinux/AppArmor and does not replace them.
	  Policy is exposed via /proc/sentinel and (optionally) securityfs.

	  If unsure, say N.

config SECURITY_SENTINEL_RUST
	bool "Sentinel LSM — Rust implementation"
	depends on SECURITY_SENTINEL && RUST
	default n
	help
	  Enables the Rust companion module for Sentinel.  This demonstrates
	  rust-for-linux patterns and the RFC-1918 classifier in safe Rust.

	  Requires CONFIG_RUST=y and a compatible Rust toolchain.
	  If unsure, say N.
```

## linux/playground/security/1/files/Kconfig
```kconfig
# security/auditsec/Kconfig
#
# Kconfig documentation: Documentation/kbuild/kconfig-language.rst
# How LSMs declare themselves: security/Kconfig (SECURITY_LOADABLE_LSMLIST)
#
# For in-tree integration:
#   1. Copy this block into security/Kconfig under the "LSM" menu
#   2. Add 'auditsec' to the LSM_ORDER list or use lsm= kernel param

config SECURITY_AUDITSEC
	tristate "auditsec audit-logging LSM"
	depends on SECURITY
	default n
	help
	  A teaching LSM that logs security-relevant events:
	  file opens, exec calls, socket creation, inode permission checks,
	  and signal delivery.

	  Operates in three modes (tunable via /sys/kernel/auditsec/enabled):
	    0 — silent (no logging, all hooks pass through)
	    1 — log-only (default): emit pr_info records, never deny
	    2 — enforce: deny exec() for the configured denied_uid

	  This module is intended for learning and should NOT be used
	  in production kernels.

	  If unsure, say N.

config SECURITY_AUDITSEC_FIXED
	tristate "auditsec (bug-fixed version)"
	depends on SECURITY
	default n
	help
	  Reference implementation with BUG-1 and BUG-2 corrected.
	  Use this to compare against the buggy version during study.

config SECURITY_AUDITSEC_RUST
	tristate "auditsec Rust LSM (requires CONFIG_RUST)"
	depends on SECURITY && RUST
	default n
	help
	  Rust language port of auditsec. Requires kernel built with
	  CONFIG_RUST=y and the rust/kernel/security.rs bindings.
	  As of v6.8 the Rust LSM trait bindings are in-flight;
	  check lore.kernel.org/rust-for-linux for current status.
```

## linux/playground/security/2/files/Kconfig
```kconfig
# Kconfig — Kernel Configuration for Guardian LSM
#
# CONCEPTS:
#   Kconfig is the kernel's configuration language. It defines:
#     - CONFIG_ options that appear in `make menuconfig`
#     - Dependencies between options (depends on)
#     - Help text shown to users
#
#   When you add your module to security/Kconfig (by inserting
#   `source "security/guardian/Kconfig"`) and to security/Makefile
#   (by adding `obj-$(CONFIG_SECURITY_GUARDIAN) += guardian/`),
#   your module becomes a first-class kernel feature.
#
#   tristate: can be built as =y (built-in), =m (module), or =n (disabled)
#   bool:     only =y or =n
#   default:  default value if not configured

config SECURITY_GUARDIAN
	tristate "Guardian LSM (educational security module)"
	depends on SECURITY
	select SECURITYFS
	default n
	help
	  This enables the Guardian Linux Security Module, a demonstration
	  LSM that audits file opens, blocks file creation in /tmp by
	  non-root processes, and audits privilege escalation.

	  This module is for educational purposes. For production systems,
	  consider SELinux, AppArmor, or SMACK.

	  If unsure, say N.
```
